## boards/shields/my_quefrency/Kconfig.shield
```kconfig
# No whitespace after the comma or in the keyboard name!
config SHIELD_MY_QUEFRENCY_DONGLE
    def_bool $(shields_list_contains,my_quefrency_dongle)

config SHIELD_MY_QUEFRENCY_LEFT
    def_bool $(shields_list_contains,my_quefrency_left)

config SHIELD_MY_QUEFRENCY_RIGHT
    def_bool $(shields_list_contains,my_quefrency_right)
```
